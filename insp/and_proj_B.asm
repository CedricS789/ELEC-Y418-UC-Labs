; ============================
; Minimal "Screen-Only" Driver
; Renders MM:SS from R25 (minutes BCD) and R20 (seconds BCD)
; Uses PB3 = DATA, PB5 = CLK, PB4 = LATCH (all outputs)
; ============================

.INCLUDE "m328pdef.inc"

.ORG 0x0000
    RJMP init

; ----------------------------
; Init: only display pins
; ----------------------------
init:
    CLI

    ; PB5 (CLK), PB3 (DATA), PB4 (LATCH) as outputs, low
    SBI DDRB,5
    CBI PORTB,5
    SBI DDRB,3
    CBI PORTB,3
    SBI DDRB,4
    CBI PORTB,4

    ; Example time to show (12:34). Replace/set R25/R20 as you like.
    LDI R25, 0x12          ; minutes BCD = 12
    LDI R20, 0x34          ; seconds BCD = 34

    SEI

main:
    RCALL display_time      ; draw MM:SS once
    RJMP main               ; keep refreshing (or replace with your own loop)

; ============================
; Display driver (screen only)
; ============================

; display_time:
; Renders five elements in order: M_tens, M_units, ':', S_tens, S_units
; Uses: R17,R18,R19,R20,R22,R23,R24,R25, Z
display_time:
    LDI R17, 0                  ; buffer byte reader
    LDI R23, 0                  ; display byte counter
    LDI R22, 0x0F               ; mask for digits
    LDI R18, 0                  ; state machine step counter

display_screen:
    LDI R18, 0                  ; reset state

draw_next:
    CPI R18, 0
    BREQ step_0_screen          ; first minute digit (tens)

    CPI R18, 1
    BREQ step_1_screen          ; second minute digit (units)

    CPI R18, 2
    BREQ step_2_screen          ; colon

    CPI R18, 3
    BREQ step_3_screen          ; first second digit (tens)

    CPI R18, 4
    BREQ step_4_screen          ; second second digit (units)

    RET                         ; all done

; ---- Extract first minute digit (high nibble of R25)
step_0_screen:
    LDI R22, 0xF0
    AND R22, R25
    LSR R22
    LSR R22
    LSR R22
    LSR R22
    RCALL check_value
    RJMP start_2

; ---- Extract second minute digit (low nibble of R25)
step_1_screen:
    LDI R22, 0x0F
    AND R22, R25
    RCALL check_value
    RJMP start_2

; ---- Colon
step_2_screen:
    LDI ZL, low(double_dot << 1)
    LDI ZH, high(double_dot << 1)
    INC R18
    RJMP start_2

; ---- Extract first second digit (high nibble of R20)
step_3_screen:
    LDI R22, 0xF0
    AND R22, R20
    LSR R22
    LSR R22
    LSR R22
    LSR R22
    RCALL check_value
    RJMP start_2

; ---- Extract second second digit (low nibble of R20)
step_4_screen:
    LDI R22, 0x0F
    AND R22, R20
    RCALL check_value
    RJMP start_2

; ---- Shift out 11 columns (each 8 bits) for the current glyph
start_2:
    LDI R17, 0x00              ; shift byte
    LDI R19, 0x00              ; column index (0..10)
    MOV R24, R18               ; copy step
    DEC R24                    ; adjust index

take_value:
    CPI R19, 11
    BREQ push_val

    CPI R19, 10
    BREQ update_index
    RJMP dont_update

update_index:
    LDI R24, 4                 ; colon alignment
dont_update:
    INC R19
    CPI R24, 4
    BREQ update_val
    LDI R17, 0x00
    INC R24
    RJMP update_iter_loop

update_val:
    LPM R17, Z+
    LDI R24, 0
update_iter_loop:
    LDI R16, 8                 ; 8 bits per column
    RJMP loop_col

; ---- Bit-bang one column
loop_col:
    DEC R16
    CLC
    ROR R17
    BRCS output_1
    CBI PORTB,3                ; DATA=0
bak:
    CBI PORTB,5                ; CLK low
    SBI PORTB,5                ; CLK high
    CBI PORTB,5                ; CLK low
    CPI R16, 0
    BREQ take_value
    RJMP loop_col

output_1:
    SBI PORTB,3                ; DATA=1
    RJMP bak

; ---- Latch after 11 columns and move to next slice
push_val:
    CBI PORTB,4                ; LATCH low
    SBI PORTB,4                ; LATCH high
    CBI PORTB,4                ; LATCH low

    LPM R17, Z+
    CPI R23, 10
    BREQ reset_r23
    INC R23
    RJMP start_2

reset_r23:
    LDI R23, 0
    CPI R18, 5
    BREQ end_display
    RJMP draw_next

end_display:
    RET

; ============================
; Digit/colon selection
; Input: R22 = digit value 0..9
; Output: Z points to glyph, R18 incremented
; ============================
check_value:
    CPI R22,0
    BREQ detected_0

    CPI R22,1
    BREQ detected_1

    CPI R22,2
    BREQ detected_2

    CPI R22,3
    BREQ detected_3

    CPI R22,4
    BREQ detected_4

    CPI R22,5
    BREQ detected_5

    CPI R22,6
    BREQ detected_6

    CPI R22,7
    BREQ detected_7

    CPI R22,8
    BREQ detected_8

    CPI R22,9
    BREQ detected_9

    ; Default to zero if out of range
detected_0:
    LDI ZL, low(zero<<1)
    LDI ZH, high(zero<<1)
    INC R18
    RET

detected_1:
    LDI ZL, low(one<<1)
    LDI ZH, high(one<<1)
    INC R18
    RET

detected_2:
    LDI ZL, low(two<<1)
    LDI ZH, high(two<<1)
    INC R18
    RET

detected_3:
    LDI ZL, low(three<<1)
    LDI ZH, high(three<<1)
    INC R18
    RET

detected_4:
    LDI ZL, low(four<<1)
    LDI ZH, high(four<<1)
    INC R18
    RET

detected_5:
    LDI ZL, low(five<<1)
    LDI ZH, high(five<<1)
    INC R18
    RET

detected_6:
    LDI ZL, low(six<<1)
    LDI ZH, high(six<<1)
    INC R18
    RET

detected_7:
    LDI ZL, low(seven<<1)
    LDI ZH, high(seven<<1)
    INC R18
    RET

detected_8:
    LDI ZL, low(eight<<1)
    LDI ZH, high(eight<<1)
    INC R18
    RET

detected_9:
    LDI ZL, low(nine<<1)
    LDI ZH, high(nine<<1)
    INC R18
    RET

; ============================
; Glyphs (exactly your tables)
; ============================

one:
	.db 0x08, 0x08, 0x80, 0x00
	.db 0x00, 0x00, 0x40, 0x00
	.db 0x08, 0x18, 0x40, 0x00
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	.db 0x00, 0x00, 0x01, 0x00

two:
	.db 0xf8, 0xf8, 0x80, 0x00
	.db 0x80, 0x08, 0x40, 0x00
	.db 0x80, 0x08, 0x20, 0x00
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	.db 0x00, 0x00, 0x01, 0x00

three:
	.db 0xf8, 0xf8, 0x80, 0x00
	.db 0x08, 0x08, 0x40, 0x00
	.db 0x08, 0x08, 0x20, 0x00
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	.db 0x00, 0x00, 0x01, 0x00

four:
	.db 0x08, 0x88, 0x80, 0x00
	.db 0x08, 0x88, 0x40, 0x00
	.db 0x08, 0x88, 0x20, 0x00
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	.db 0x00, 0x00, 0x01, 0x00

five:
	.db 0x08, 0xf8, 0x80, 0x00
	.db 0x08, 0x80, 0x40, 0x00
	.db 0x08, 0x80, 0x20, 0x00
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	.db 0x00, 0x00, 0x01, 0x00

six:
	.db 0xf8, 0xf8, 0x80, 0x00
	.db 0x88, 0x80, 0x40, 0x00
	.db 0x88, 0x80, 0x20, 0x00
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	.db 0x00, 0x00, 0x01, 0x00

seven:
	.db 0x08, 0xf8, 0x80, 0x00
	.db 0x08, 0x08, 0x40, 0x00
	.db 0x08, 0x08, 0x20, 0x00
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	.db 0x00, 0x00, 0x01, 0x00

eight:
	.db 0x88, 0xf8, 0x80, 0x00
	.db 0x88, 0x88, 0x40, 0x00
	.db 0x88, 0x88, 0x20, 0x00
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	.db 0x00, 0x00, 0x01, 0x00

nine:
	.db 0xf8, 0xf8, 0x80, 0x00
	.db 0x08, 0x88, 0x40, 0x00
	.db 0x08, 0x88, 0x20, 0x00
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	.db 0x00, 0x00, 0x01, 0x00

zero:
	.db 0x88, 0xf8, 0x80, 0x00
	.db 0x88, 0x88, 0x40, 0x00
	.db 0x88, 0x88, 0x20, 0x00
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	.db 0x00, 0x00, 0x01, 0x00

double_dot:
	.db 0x00, 0x00, 0x40, 0x00
	.db 0x00, 0x00, 0x31, 0x00
	.db 0x18, 0x18, 0x21, 0x00
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	.db 0x00, 0x00, 0x01, 0x00